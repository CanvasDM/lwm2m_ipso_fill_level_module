## Kconfig
```kconfig
#
# Copyright (c) 2022 Laird Connectivity LLC
#
# SPDX-License-Identifier: LicenseRef-LairdConnectivity-Clause
#
menuconfig LCZ_LWM2M_FILL_LEVEL
	bool "Enable LwM2M Fill Level Object"
	depends on LCZ_LWM2M_UTIL
	depends on LCZ_LWM2M_IPSO_FILLING_SENSOR
	select LCZ_SNPRINTK

if LCZ_LWM2M_FILL_LEVEL

module=LCZ_LWM2M_FILL_LEVEL
module-str=FILL_LEVEL
source "subsys/logging/Kconfig.template.log_config"

endif # LCZ_LWM2M_FILL_LEVEL
```
